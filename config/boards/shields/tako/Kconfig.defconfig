## config/boards/shields/tako/Kconfig.defconfig
```kconfig
# The side with the PS2 Mouse / TP has to be the central half

if SHIELD_TAKO_DONGLE
# 有 PS2 USB/TP 的USB必须是中央一半
config ZMK_KEYBOARD_NAME
  default "Tako dongle"

config ZMK_SPLIT_ROLE_CENTRAL
  default y

config ZMK_USB
	default y

endif

if SHIELD_TAKO_LEFT || SHIELD_TAKO_RIGHT || SHIELD_TAKO_DONGLE


config ZMK_SPLIT
  default y

config ZMK_BLE
	default y

endif
```

## config/west.yml
```yaml
manifest:
  remotes:
    - name: solodros
      url-base: https://github.com/solodros
  projects:
    - name: zmk
      remote: solodros
      revision: ps2
      import: app/west.yml
  self:
    path: config
```
